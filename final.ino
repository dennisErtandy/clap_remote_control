#include <IRremote.h>

const unsigned int  rawDataOn[] PROGMEM = {604, 17908, 3032, 8940, 548, 448, 552, 1464, 528, 452, 548, 468, 528,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 1468, 524}; 
const unsigned int  rawDataOff[] PROGMEM = {608, 17848, 3032, 8936, 556, 444, 552, 1464, 528, 472, 528, 468, 528,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 1472, 520};

void setup() {
  // put your setup code here, to run once:
Serial.begin(9600);
}
 IRsend irsend;
void loop() {
  // put your main code here, to run repeatedly:

int state_ptr;
int stage = 0;

int k = 0 ;
if (stage == 0 && analogRead(A0)>1000)
{
  delay(50);
  k=0;
  for(k=0;k<10;k++)
  {
    delay (10);
    if(analogRead(A0)<1000)
    {
        
       stage++;

       break;
     }
   }
   

delay(150);

k=0;
for(k=0;k<250;k++)
  {
    delay(2);
    if (stage == 1 && analogRead(A0)>1000)
      {
        k=0;
        for(k =0;k<10;k++)
        {
          delay (10);
          if(analogRead(A0)<1000)
          {
            stage++;          
         
            transmit(&state_ptr);
            break;
          }
          
        }
      }
  }

}

}
int transmit(int *state_ptr)
{ 
  int khz = 38;
  
  unsigned int buf[349];
  
 if (*state_ptr == 0)
 {

  memcpy_P (buf, rawDataOn, sizeof(rawDataOn));

  
  irsend.sendRaw(buf, sizeof(buf) / sizeof(buf[0]), khz);
  *state_ptr =+ 1;
  return 0;
 }
 if(*state_ptr==1)
 {
 
memcpy_P (buf, rawDataOff, sizeof(rawDataOn));

  
 irsend.sendRaw(buf, sizeof(buf) / sizeof(buf[0]), khz);
 *state_ptr-=1 ;
 return 0 ;
 }

   
 else
 {
  *state_ptr = 0;
 }
  
}
